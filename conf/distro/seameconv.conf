## conf/layer.conf
```bitbake
# We have a conf and classes directory, add to BBPATH
BBPATH .= ":${LAYERDIR}"

# We have recipes-* directories, add to BBFILES
BBFILES += "${LAYERDIR}/recipes-*/*/*.bb \
            ${LAYERDIR}/recipes-*/*/*.bbappend"

BBFILE_COLLECTIONS += "meta-seameconv"
BBFILE_PATTERN_meta-seameconv = "^${LAYERDIR}/"
BBFILE_PRIORITY_meta-seameconv = "6"

LAYERDEPENDS_meta-seameconv = "core"
LAYERSERIES_COMPAT_meta-seameconv = "kirkstone"
```
